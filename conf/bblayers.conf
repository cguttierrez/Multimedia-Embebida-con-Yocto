## conf/bblayers.conf
```bitbake
# POKY_BBLAYERS_CONF_VERSION is increased each time build/conf/bblayers.conf
# changes incompatibly
POKY_BBLAYERS_CONF_VERSION = "2"

BBPATH = "${TOPDIR}"
BBFILES ?= ""

BBLAYERS ?= " \
  /home/carlos/Yocto/poky/meta \
  /home/carlos/Yocto/poky/meta-poky \
  /home/carlos/Yocto/meta-openembedded/meta-oe \
  /home/carlos/Yocto/meta-openembedded/meta-multimedia \
  /home/carlos/Yocto/meta-openembedded/meta-python \
  /home/carlos/Yocto/poky/meta-custom \
  /home/carlos/Yocto/poky/meta-yocto-bsp \
  "
```
